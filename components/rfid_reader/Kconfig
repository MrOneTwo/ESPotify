## components/rfid_reader/Kconfig
```kconfig
# Michal Ciesielski 2021
# Configuration file for RFID Reader module.


menu "RFID Reader component"
    config RFID_READER
        bool "Enable RFID Reader module"
        default y
        help
            Toggle RFID Reader module

if RFID_READER

    choice RFID_READER_DRIVER
        prompt "RFID reader driver"
        default RC522
        config RC522
            bool "RC522 based reader"
            help
                Choose RFID reader type
        config PN532
            bool "PN532 based reader"
            help
                Choose RFID reader type
    endchoice

endif # RFID_READER
endmenu
```

## components/spotify/Kconfig
```kconfig
# Michal Ciesielski 2021
# Configuration file for ESP32 Spotify module.

menu "Spotify component"
    config SPOTIFY_CLIENT_ID
        string "Spotify client ID"
        default "EMPTY"
        help
            Spotify's client ID

    config SPOTIFY_CLIENT_SECRET
        string "Spotify client secret"
        default "EMPTY"
        help
            Spotify's client secret

    config SPOTIFY_REFRESH_TOKEN
        string "Spotify refresh token"
        default "EMPTY"
        help
            Spotify's refresh token
endmenu
```

## main/Kconfig.projbuild
```kconfig
# Michal Ciesielski 2021
# Configuration file for ESPotify project.

menu "ESPotify project configuration"

    config ESP_WIFI_SSID
        string "WiFi SSID"
        default "SSID"
        help
            SSID (network name) for the example to connect to.

    config ESP_WIFI_PASSWORD
        string "WiFi Password"
        default "password"
        help
            WiFi password (WPA or WPA2) for the example to use.

    config ESP_MAXIMUM_RETRY
        int "Maximum retry"
        default 5
        help
            Set the Maximum retry to avoid station reconnecting to the AP unlimited when the AP is really inexistent.

endmenu
```
